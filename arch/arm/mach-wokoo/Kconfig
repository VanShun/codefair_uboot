## arch/arm/mach-wokoo/Kconfig
```kconfig
config HAS_CAAM
	bool

config WOKOO_CONFIG
	string

config ROM_UNIFIED_SECTIONS
	bool

config GPT_TIMER
	bool

config SECURE_BOOT
	bool "Support WOKOO secure boot features"
	depends on ARCH_WOKOO
	select FSL_CAAM if HAS_CAAM
	imply CMD_DEKBLOB
	help
	  This option enables the support for secure boot.
```

## arch/arm/mach-wokoo/wokoo/Kconfig
```kconfig
if ARCH_WOKOO

config WOKOO
	bool
	select HAS_CAAM
	select ROM_UNIFIED_SECTIONS
#	select SYSCOUNTER_TIMER
	select SYS_L2CACHE_OFF

config SYSCOUNTER_TIMER
	bool "Select system timer"

choice
	prompt "WOKOO board select"
	optional

config TARGET_WOKOO_CODEFAIR
	bool "Support code fair WOKOO"
	select BOARD_LATE_INIT
	select DM
#	select DM_ETH
#	select DM_I2C
#	select DM_MMC
#	select DM_THERMAL
	select WOKOO
	select OF_CONTROL
	select SPL_DM if SPL
#	select SPL_OF_CONTROL if SPL
#	select SPL_PINCTRL if SPL
#	select SPL_SEPARATE_BSS if SPL
	select SUPPORT_SPL
#	imply CMD_DM

endchoice

config SYS_SOC
	default "wokoo"

config WOKOO_MINI
	bool "Support WOKOO Minimum u-boot configuration"
config WOKOO_APP
	bool "Support SPL LOAD APP configuration"
config WOKOO_DDR3
	bool "Support dd3 configuration"
source "board/codefair/wokoo/Kconfig"

endif
```

## board/codefair/wokoo/Kconfig
```kconfig
if TARGET_WOKOO_CODEFAIR

config SYS_BOARD
	default "wokoo"

config SYS_VENDOR
	default "codefair"

config SYS_CONFIG_NAME
	default "codefair"

endif
```

## configs/wokoo_codefair_dm_defconfig
```kconfig
CONFIG_ARM=y
CONFIG_ARCH_WOKOO=y
CONFIG_SYS_TEXT_BASE=0x01E00000
CONFIG_SPL_GPIO_SUPPORT=y
CONFIG_SPL_LIBCOMMON_SUPPORT=y
CONFIG_SPL_LIBGENERIC_SUPPORT=y
CONFIG_TARGET_WOKOO_CODEFAIR=y
CONFIG_SPL_SERIAL_SUPPORT=y
CONFIG_NR_DRAM_BANKS=1
CONFIG_SPL=y
CONFIG_SPL_BOARD_INIT=y
CONFIG_SPL_MTD_SUPPORT=y
CONFIG_SPL_SPI_FLASH_SUPPORT=y
CONFIG_SPL_SPI_SUPPORT=y
CONFIG_SPL_SPI_LOAD=y
CONFIG_SPL_YMODEM_SUPPORT=y
CONFIG_SYS_SPI_U_BOOT_OFFS=0x010000
# CONFIG_CMD_BMODE is not set
CONFIG_SPL_TEXT_BASE=0x9FF80000
CONFIG_SYS_MALLOC_F_LEN=0x4000
CONFIG_FIT=y
CONFIG_FIT_SIGNATURE=y
CONFIG_FIT_VERBOSE=y
CONFIG_LEGACY_IMAGE_FORMAT=y
CONFIG_BOOTDELAY=3
CONFIG_SUPPORT_RAW_INITRD=y
CONFIG_BOUNCE_BUFFER=y
CONFIG_SPL_DMA_SUPPORT=y
CONFIG_SPL_WATCHDOG_SUPPORT=y
CONFIG_SPL_USB_GADGET=y
##CONFIG_WDT=y
##CONFIG_WOKOO_WATCHDOG=y
CONFIG_HUSH_PARSER=y
CONFIG_SYS_PROMPT="u-boot > "
CONFIG_CRC32_VERIFY=y
CONFIG_CMD_MEMTEST=y
##CONFIG_DM_GPIO=y
CONFIG_CMD_GPIO=y
CONFIG_CMD_CACHE=y
CONFIG_CMD_SF=y
CONFIG_CMD_MTDPARTS=y
CONFIG_MTDIDS_DEFAULT="nor0=spi0.0"
CONFIG_MTDPARTS_DEFAULT="mtdparts=spi0.0:64k(spl),448k(u-boot),512k(dtb),5m(uImage),-(user)"
CONFIG_CMD_FS_GENERIC=y
CONFIG_MTD=y
CONFIG_MTD_DEVICE=y
CONFIG_SPI=y
CONFIG_DM_SPI=y
CONFIG_DM_SPI_FLASH=y
CONFIG_SPL_OF_LIBFDT=y
CONFIG_SPL_OF_CONTROL=y
CONFIG_SPL_DM_SEQ_ALIAS=y
CONFIG_SPI_FLASH=y
CONFIG_SPI_FLASH_STMICRO=y
CONFIG_SPI_FLASH_GIGADEVICE=y
CONFIG_SPI_FLASH_MTD=y
CONFIG_SPI_FLASH_WINBOND=y
CONFIG_SPI_FLASH_MACRONIX=y
CONFIG_SPI_FLASH_XMC=y
CONFIG_SPI_FLASH_EON=y
CONFIG_ENV_IS_IN_SPI_FLASH=y
# CONFIG_SPI_FLASH_USE_4K_SECTORS is not set
CONFIG_WOKOO_QSPI=y
CONFIG_WOKOO_SSI=y
CONFIG_DEFAULT_DEVICE_TREE="wokoo-codefair"
CONFIG_DM_SERIAL=y
CONFIG_WOKOO_UART=y
CONFIG_WOKOO_DMAG=y
CONFIG_USB=y
CONFIG_CMD_USB=y
CONFIG_DM_USB=y
CONFIG_USB_STORAGE=y
CONFIG_USB_GADGET_DWC2_OTG=y
CONFIG_USB_DWC2=y
#CONFIG_DM_USB_GADGET=y
#CONFIG_SPL_DM_USB_GADGET=y
CONFIG_USB_HOST_ETHER=y
CONFIG_USB_ETHER_SMSC95XX=y
CONFIG_USB_GADGET=y
CONFIG_FASTBOOT=y
CONFIG_CMD_FASTBOOT=y
CONFIG_USB_FUNCTION_FASTBOOT=y
CONFIG_FASTBOOT_BUF_ADDR=0x8000
CONFIG_FASTBOOT_BUF_SIZE=0x2000000
CONFIG_FASTBOOT_FLASH=y
CONFIG_SYS_ARCH_TIMER=y
```

## configs/wokoo_codefair_mini_ssi_defconfig
```kconfig
CONFIG_ARM=y
CONFIG_ARCH_WOKOO=y
CONFIG_SYS_TEXT_BASE=0x01E00000
CONFIG_SPL_GPIO_SUPPORT=y
CONFIG_SPL_LIBCOMMON_SUPPORT=y
CONFIG_SPL_LIBGENERIC_SUPPORT=y
CONFIG_TARGET_WOKOO_CODEFAIR=y
CONFIG_SPL_SERIAL_SUPPORT=y
CONFIG_NR_DRAM_BANKS=1
CONFIG_SPL=y
CONFIG_SPL_MTD_SUPPORT=y
CONFIG_SPL_SPI_FLASH_SUPPORT=y
CONFIG_SPL_SPI_SUPPORT=y
CONFIG_SPL_SPI_LOAD=y
CONFIG_SYS_SPI_U_BOOT_OFFS=0x010000
# CONFIG_CMD_BMODE is not set
CONFIG_SPL_TEXT_BASE=0x9FF80000
CONFIG_SYS_MALLOC_F_LEN=0x4000
CONFIG_BOOTDELAY=0
CONFIG_SPL_DMA_SUPPORT=y
CONFIG_SPL_WATCHDOG_SUPPORT=y
CONFIG_SYS_PROMPT="u-boot > "
CONFIG_CMD_SF=y
CONFIG_CMD_MTDPARTS=y
CONFIG_MTDIDS_DEFAULT="nor0=spi1.0"
CONFIG_MTDPARTS_DEFAULT="mtdparts=spi1.0:64k(spl),448k(u-boot),512k(dtb),2m(uImage),-(user)"
# CONFIG_CMD_NET is not set
# CONFIG_CMD_MEMORY is not set
# CONFIG_CMD_BDI is not set
# CONFIG_CMD_BOOTEFI is not set
# CONFIG_CMD_CACHE is not set
# CONFIG_CMD_ELF is not set
# CONFIG_CMD_FDT is not set
# CONFIG_CMD_FLASH is not set
# CONFIG_CMD_FS_GENERIC is not set
# CONFIG_CMD_ITEST is not set
# CONFIG_CMD_MISC is not set
# CONFIG_CMD_GPIO is not set
# CONFIG_CMD_NVEDIT_EFI is not set
# CONFIG_CMD_SETEXPR is not set
# CONFIG_CMD_SOURCE is not set
# CONFIG_CMD_XIMG is not set
CONFIG_SPI=y
CONFIG_SPI_FLASH=y
CONFIG_SPI_FLASH_STMICRO=y
CONFIG_SPI_FLASH_GIGADEVICE=y
CONFIG_SF_DEFAULT_BUS=1
CONFIG_SF_DEFAULT_SPEED=8000000
CONFIG_WOKOO_SSI=y
CONFIG_DEFAULT_DEVICE_TREE="wokoo-codefair"
CONFIG_WOKOO_UART=y
CONFIG_WOKOO_DMAG=y
CONFIG_WOKOO_MINI=y
CONFIG_SYS_ARCH_TIMER=y
```
